## Kconfig
```kconfig
rsource "modules/non-lipo/Kconfig"
rsource "modules/threshold-layer/Kconfig"
rsource "modules/pointer-mode/Kconfig"
rsource "modules/trackball-wake/Kconfig"
```

## config/boards/shields/voltball/Kconfig.shield
```kconfig
config SHIELD_VOLTBALL_LEFT
    def_bool $(shields_list_contains,voltball_left)

config SHIELD_VOLTBALL_RIGHT
    def_bool $(shields_list_contains,voltball_right)

config SHIELD_VOLTBALL_DONGLE
    def_bool $(shields_list_contains,voltball_dongle)
```

## dts/bindings/zmk,behavior-voltball-pointer.yaml
```yaml
# SPDX-License-Identifier: MIT

description: |
  Voltball pointer control. Param is PTR_SPD_UP, PTR_SPD_DN, PTR_SPD_RST,
  PTR_SCRL_TOG or PTR_SCRL_MO from dt-bindings/voltball/pointer_mode.h.

compatible: "zmk,behavior-voltball-pointer"

include: one_param.yaml
```

## dts/bindings/zmk,input-processor-threshold-temp-layer.yaml
```yaml
# Copyright (c) 2024 The ZMK Contributors
# SPDX-License-Identifier: MIT

description: |
  Latched auto-mouse layer activated by accumulated pointer movement.
  A non-modifier press on a key that is &trans on that layer cancels it and
  is delivered normally (QMK style). Requires the pinned ZMK behavior-dispatch hook.

compatible: "zmk,input-processor-threshold-temp-layer"

include: ip_zero_param.yaml

properties:
  activation-threshold:
    type: int
    default: 0
    description: |
      Minimum accumulated absolute X/Y sensor counts required to activate the layer.
      Zero activates on the first nonzero motion report.

  require-prior-idle-ms:
    type: int
    default: 0
    description: |
      Suppress activation after a non-modifier press on an exit (&trans) key.
      Suppressed movement is discarded, not accumulated.

  mouse-layer:
    type: int
    required: true
    description: |
      Index of the latched layer. Exit keys are read from its bindings, so it
      must be known before any motion.
```

## dts/bindings/zmk,input-processor-voltball-pointer.yaml
```yaml
# SPDX-License-Identifier: MIT

description: |
  Voltball pointer speed and scroll mode. Use twice in one listener chain:
  PTR_STAGE_MODE before auto mouse (converts X/Y to wheel while scroll mode is on)
  and PTR_STAGE_SPEED after it (scales pointer X/Y). Controlled by &ptr.

compatible: "zmk,input-processor-voltball-pointer"

include: ip_one_param.yaml

properties:
  pointer-scales:
    type: array
    required: true
    description: Pointer speed steps as mul/div pairs, slowest first.
  pointer-default-index:
    type: int
    required: true
  scroll-scales:
    type: array
    required: true
    description: Scroll speed steps as mul/div pairs, slowest first.
  scroll-default-index:
    type: int
    required: true
  scroll-invert-y:
    type: boolean
  deadzone:
    type: int
    default: 0
    description: |
      Sensor counts the ball must move after a rest before motion is passed on.
      0 disables. Applies to pointer and scroll mode.
  deadzone-reset-ms:
    type: int
    default: 100
    description: Pause after which the deadzone applies again.
```

## modules/pointer-mode/Kconfig
```kconfig
# SPDX-License-Identifier: MIT

if ZMK_POINTING

config ZMK_VOLTBALL_POINTER_MODE
    bool "Voltball pointer speed and scroll mode keys"
    default y
    depends on DT_HAS_ZMK_INPUT_PROCESSOR_VOLTBALL_POINTER_ENABLED
    depends on DT_HAS_ZMK_BEHAVIOR_VOLTBALL_POINTER_ENABLED
    help
      &ptr steps pointer or scroll speed and switches the trackball between
      pointer and scroll mode without a keymap layer. Steps persist in settings.

endif # ZMK_POINTING
```

## modules/threshold-layer/Kconfig
```kconfig
# Copyright (c) 2024 The ZMK Contributors
# SPDX-License-Identifier: MIT

if ZMK_POINTING

config ZMK_INPUT_PROCESSOR_THRESHOLD_TEMP_LAYER
    bool "Voltball latched automatic mouse layer"
    default y
    depends on DT_HAS_ZMK_INPUT_PROCESSOR_THRESHOLD_TEMP_LAYER_ENABLED
    help
      Latch the mouse layer after pointer motion reaches the threshold.
      Requires the pinned ZMK behavior hook installed by patch_auto_mouse.py.
      A non-modifier press on a key that is &trans on the layer exits it and
      is still delivered. Modifier actions keep the layer.

endif # ZMK_POINTING
```

## modules/trackball-wake/Kconfig
```kconfig
# SPDX-License-Identifier: MIT

config VOLTBALL_TRACKBALL_WAKE
    bool "Wake from deep sleep on trackball motion (experimental)"
    default y
    depends on ZMK_SLEEP && PM_DEVICE
    depends on $(dt_nodelabel_bool_prop,trackball_central,wakeup-source)
    help
      Keeps the PAW3222 out of ZMK's suspend so it stays in its own low-power
      sleep with the motion pin armed; motion then wakes the half from deep sleep.
```

## modules/wake-trace/Kconfig
```kconfig
# SPDX-License-Identifier: MIT

config VOLTBALL_WAKE_TRACE
    bool "Log how long a half takes to come back after deep sleep"
    depends on ZMK_SPLIT_ROLE_CENTRAL && BT_CENTRAL && LOG
    help
      Diagnostic build only. On the dongle, logs "[wake]" lines when a half's
      split advertisement is first seen, when it connects, when encryption and
      the connection interval are settled, and when its first key or trackball
      input arrives, with the time since the advertisement was seen.
```
