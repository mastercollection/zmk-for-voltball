/ {
    input_splits {
        #address-cells = <1>;
        #size-cells = <0>;
        trackball_split: input_split@0 {
            compatible = "zmk,input-split";
            reg = <0>;
        };
    };
};
